## boards/shields/wallet42/Kconfig.defconfig
```kconfig
# Copyright (c) 2021 The ZMK Contributors
# SPDX-License-Identifier: MIT

if SHIELD_WALLET42

config ZMK_KEYBOARD_NAME
    default "wallet42"

endif
```

## boards/shields/wallet42/Kconfig.shield
```kconfig
# Copyright (c) 2021 The ZMK Contributors
# SPDX-License-Identifier: MIT

config SHIELD_WALLET42
    def_bool $(shields_list_contains,wallet42)
```
